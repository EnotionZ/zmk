## app/boards/shields/dom4x6/Kconfig.shield
```kconfig
config SHIELD_DOM4X6_LEFT
    def_bool $(shields_list_contains,dom4x6_left)

config SHIELD_DOM4X6_RIGHT
    def_bool $(shields_list_contains,dom4x6_right)
```

## app/boards/shields/tg4x_dom/Kconfig.defconfig
```kconfig
# Copyright (c) 2020 The ZMK Contributors
# SPDX-License-Identifier: MIT

if SHIELD_TG4X_DOM

config ZMK_KEYBOARD_NAME
    default "Pham TG4x"

endif
```

## app/boards/shields/tg4x_dom/Kconfig.shield
```kconfig
# Copyright (c) 2020 The ZMK Contributors
# SPDX-License-Identifier: MIT

config SHIELD_TG4X_DOM
    def_bool $(shields_list_contains,tg4x_dom)
```
